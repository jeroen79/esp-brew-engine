## loader/main/Kconfig.projbuild
```kconfig
menu "BrewEngine Config"

    config WIFI_SSID
        string "Wifi SSID"
        default "EspBrewEngine"
        help
            Wifi SSID, case sensitive!.

    config WIFI_PASS
        string "Wifi WPA pass"
        default "EspBrewEngine123"
        help
            Wifi WPA pass.

    config WIFI_AP
        bool "Use Wifi AP"
        default y
        help
            Starts a wifi Access Point so the user can connect and configure wifi in the web gui.

    config HOSTNAME
        string "Hostname"
        default "BrewEngine"
        help
            Hostname to use for network.
endmenu
```

## loader/sdkconfig.defaults
```kconfig
CONFIG_COMPILER_CXX_EXCEPTIONS=n

CONFIG_PARTITION_TABLE_CUSTOM=y
CONFIG_PARTITION_TABLE_CUSTOM_FILENAME="partitions.csv"
CONFIG_PARTITION_TABLE_FILENAME="partitions.csv"
CONFIG_PARTITION_TABLE_MD5=y
CONFIG_ESPTOOLPY_FLASHSIZE_4MB=y
CONFIG_ESPTOOLPY_HEADER_FLASHSIZE_UPDATE=y

# CONFIG_ESP_WIFI_ENABLE_WPA3_SAE=n
# CONFIG_ESP_WIFI_ENABLE_WPA3_OWE_STA=n
CONFIG_ESP_WIFI_ENTERPRISE_SUPPORT=n

CONFIG_PM_ENABLE=n

CONFIG_OPTIMIZATION_ASSERTIONS_SILENT=y
CONFIG_COMPILER_OPTIMIZATION_ASSERTION_LEVEL=1
CONFIG_LOG_BOOTLOADER_LEVEL=1
CONFIG_LOG_BOOTLOADER_LEVEL_ERROR=y
# CONFIG_LOG_DEFAULT_LEVEL_ERROR=y
# CONFIG_LOG_DEFAULT_LEVEL=1
# CONFIG_LOG_MAXIMUM_EQUALS_DEFAULT=y
# CONFIG_LOG_MAXIMUM_LEVEL=1
CONFIG_NEWLIB_NANO_FORMAT=y
# CONFIG_ETH_USE_ESP32_EMAC=n
# CONFIG_ETH_USE_SPI_ETHERNET=n
```

## main/Kconfig.projbuild
```kconfig
menu "BrewEngine Config"

    config WIFI_SSID
        string "Wifi SSID"
        default "EspBrewEngine"
        help
            Wifi SSID, case sensitive!.

    config WIFI_PASS
        string "Wifi WPA pass"
        default "EspBrewEngine123"
        help
            Wifi WPA pass.

    config WIFI_AP
        bool "Use Wifi AP"
        default y
        help
            Starts a wifi Access Point so the user can connect and configure wifi in the web gui.

    config HOSTNAME
        string "Hostname"
        default "BrewEngine"
        help
            Hostname to use for network.

    config MQTT_URI
        string "MQTT URI"
        default ""
        help
            
            When configured esp-brew-engine will log temperatures to mqtt.

            Example:
            mqtt://user:password@192.168.0.1:1883
            mqtt://user:password@[fd88:ff06:bbf9:0:aaa1:59ff:fe89:4dcf]:1883
            
    config ONEWIRE
        int "OneWire Pin"
        default 17
        help
            OneWire Pin

    config HEAT1
        int "HEAT1 Pin"
        default 32
        help
            HEAT1 Pin
            Must be enabled!

    config HEAT2
        int "HEAT2 Pin"
        default 33
        help
            HEAT2 Pin
            Set to 0 to disable!
    
    config STIR
        int "STIR Pin"
        default 25
        help
            STIR Pin
            Set to 0 to disable!

    config InvertOutputs
        bool "Invert Outputs"
        default n
        help
            Invert the output direction Low/High

    choice
        prompt "Default Temperature Scale"
        config SCALE_CELCIUS
            bool "Celcius"
        config SCALE_FAHRENHEIT
            bool "Fahrenheit"
    endchoice

    config PID_LOOPTIME
        int "PID Looptime"
        default 60
        help
            PID LOOPTIME
            Default time between pid calc and ajust, since water heating is a slow proccess this works best at 60sec.


endmenu
```

## sdkconfig.defaults
```kconfig
# Enable C++ exceptions and set emergency pool size for exception objects
CONFIG_COMPILER_CXX_EXCEPTIONS=y
CONFIG_COMPILER_CXX_EXCEPTIONS_EMG_POOL_SIZE=1024

CONFIG_PARTITION_TABLE_CUSTOM=y
CONFIG_PARTITION_TABLE_CUSTOM_FILENAME="partitions.csv"
CONFIG_PARTITION_TABLE_FILENAME="partitions.csv"
CONFIG_PARTITION_TABLE_MD5=y
CONFIG_ESPTOOLPY_FLASHSIZE_4MB=y
CONFIG_ESPTOOLPY_HEADER_FLASHSIZE_UPDATE=y


#
# Power Management
#
CONFIG_PM_ENABLE=y
CONFIG_PM_DFS_INIT_AUTO=y
CONFIG_PM_POWER_DOWN_CPU_IN_LIGHT_SLEEP=y
# end of Power Management

#
# ESP-MQTT Configurations
#
CONFIG_MQTT_PROTOCOL_311=n
CONFIG_MQTT_PROTOCOL_5=y
CONFIG_MQTT_TRANSPORT_SSL=y
CONFIG_MQTT_TRANSPORT_WEBSOCKET=y
CONFIG_MQTT_TRANSPORT_WEBSOCKET_SECURE=y

#
# Wifi, some boards seem to have issues at 20dbm so we default to 15, can later be change in gui
#
CONFIG_ESP_PHY_MAX_WIFI_TX_POWER=15
CONFIG_ESP_PHY_MAX_TX_POWER=15
```
